#include <Wire.h>
#include <Adafruit_Sensor.h>
#include <Adafruit_BMP280.h>
#include "U8glib.h"
#include <EEPROM.h>
#include <math.h>
#include <VoltageReference.h>
#include <Tone.h>

VoltageReference vRef;
U8GLIB_SSD1306_128X64 u8g(U8G_I2C_OPT_NO_ACK);
Adafruit_BMP280 sensor_bmp;

Tone tone_out1;
Tone tone_out2;

// #define buzzer 10
short speaker_pin1 = 9;   //arduino speaker output -
short speaker_pin2 = 10;  //arduino speaker output +

float vario_down = -1.2;
float vario_emergence = -5.5;
float vario_up = 0.3;

float vario_up_arr[4];
float vario_down_arr[4];

float alt[51];
float tim[51];
float beep;
float Beep_period;

float Alt = 0;
float vario = 0;

float Altitude = 0;
float alt_arr[10];
int alt_count = 0;

float Altitude_0 = 0;
float alt_0[10];
int alt_0_count = 0;

float Temperature = 0;

unsigned long bounseInput4P = 0UL;
unsigned long time;

unsigned char samples = 10;
unsigned char maxsamples = 50;
unsigned char countPressVal = 0;

//button
int buttonState = 0;

//clock
unsigned char relogio = 0;
unsigned char segundo = 0, minuto = 0, hora = 0;
unsigned long UtlTime;
unsigned long lastMillis;

//variables to confirm takeoff
unsigned long temp_alt;
unsigned char temp_verif_alt = 0;
unsigned char ult_altitude;

//variables
// int num_memo = 0;
float Max_Vario_UP = 00.0;
float Max_Vario_DOWN = 00.0;
float Max_Altitude = 0000.0;

int endfly;
int end_memo = 1;
unsigned long gravatempo;
int ler = 1;
int decolagem = 0;

boolean isDebug = false;

void play_beep()  //звуковой сигнал
{
  for (int aa = 100; aa <= 800; aa = aa + 100) {
    tone_out1.play(aa, 200);
    tone_out2.play(aa + 3, 200);
    delay(50);
  }
}
void play_welcome_beep()  //звук приветствия
{
  for (int aa = 100; aa <= 800; aa = aa + 100) {
    tone_out1.play(aa, 200);
    tone_out2.play(aa + 3, 200);
    delay(50);
  }
}

const uint8_t rook_bitmap[] PROGMEM = {
  0xff, 0xff, 0xff, 0xff, 0xff, 0xff, 0xff, 0xff, 0xff, 0xff, 0xff, 0xff, 0xff, 0xff, 0xff, 0xff,
  0xff, 0xff, 0xff, 0xff, 0xff, 0xff, 0xff, 0xff, 0xff, 0xff, 0xff, 0xff, 0xff, 0xff, 0xff, 0xff,
  0xff, 0xff, 0xff, 0xff, 0xff, 0xff, 0xff, 0xff, 0xff, 0xff, 0xff, 0xff, 0xff, 0xff, 0xff, 0xff,
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  0xff, 0xff, 0xff, 0xff, 0xff, 0xff, 0xff, 0xff, 0xff, 0xff, 0xff, 0xff, 0xff, 0xff, 0xff, 0xff
};

void draw2() {
  float delta = 0.3;
  float time = millis();
  if (time < 2500) {
    u8g.setColorIndex(1);
    u8g.drawBitmapP( 0, 0, 16, 64, rook_bitmap);
  } else {
    u8g.setColorIndex(0);
    u8g.setColorIndex(1);
    u8g.setFont(u8g_font_8x13Br);

    //frames
    u8g.drawRFrame(44, -1, 85, 50, 0);
    u8g.drawRFrame(44, 48, 85, 30, 0);

    //Temparature
    int temparatute_int = round(Temperature);
    int temparatute_dec = round((Temperature - temparatute_int) * 10);
    u8g.setPrintPos(2, 30);
    u8g.print(temparatute_int - 1);
    u8g.print(".");
    u8g.print(abs(temparatute_dec));
    u8g.print("c");

    //alt
    u8g.setPrintPos(50, 64);
    if (abs(Altitude - Altitude_0) > delta) {
      u8g.print(round(Altitude - Altitude_0));
    } else {
      u8g.print(0);
    }
    u8g.print("m");

    //vario
    //ms
    u8g.setPrintPos(100, 45);
    u8g.print("m/s");

    //value
    int vario_int = round(vario);
    int vario_dec = round((vario - vario_int) * 10);
    u8g.setScale2x2();
    u8g.setPrintPos(23, 13);
    if (abs(vario) > delta) {
      if (vario < -0) {
        u8g.print("-");
      }
      u8g.setPrintPos(32, 13);
      u8g.print(abs(vario_int));
      u8g.print(".");
      u8g.print(abs(vario_dec));
    } else {
      u8g.setPrintPos(32, 13);
      u8g.print("0.0");
    }
    u8g.undoScale();

    // setts
    u8g.setPrintPos(2, 48);
    u8g.print(vario_up_arr[buttonState]);
    if (buttonState == 0) {
      u8g.drawBox(2, 60, 5, 3);
      u8g.drawRFrame(10, 57, 5, 6, 0);
      u8g.drawRFrame(18, 54, 5, 9, 0);
      u8g.drawRFrame(26, 51, 5, 12, 0);
    }
    if (buttonState == 1) {
      u8g.drawBox(2, 60, 5, 3);
      u8g.drawBox(10, 57, 5, 6);
      u8g.drawRFrame(18, 54, 5, 9, 0);
      u8g.drawRFrame(26, 51, 5, 12, 0);
    }
    if (buttonState == 2) {
      u8g.drawBox(2, 60, 5, 3);
      u8g.drawBox(10, 57, 5, 6);
      u8g.drawBox(18, 54, 5, 9);
      u8g.drawRFrame(26, 51, 5, 12, 0);
    }
    if (buttonState == 3) {
      u8g.drawBox(2, 60, 5, 3);
      u8g.drawBox(10, 57, 5, 6);
      u8g.drawBox(18, 54, 5, 9);
      u8g.drawBox(26, 51, 5, 12);
    }

    // triangle
    u8g.setFont(u8g_font_10x20_75r);
    u8g.setPrintPos(50, 45);
    // u8g.print("<");

    if (vario > 0.3) { u8g.print("2"); }
    if (vario < -0.3) { u8g.print("<"); }

    u8g.setPrintPos(65, 45);
    if (vario > 1) { u8g.print("2"); }
    if (vario < -1) { u8g.print("<"); }

    u8g.setPrintPos(80, 45);
    if (vario > 2) { u8g.print("2"); }
    if (vario < -2) { u8g.print("<"); }

    // vcc
    int vcc = vRef.readVcc();
    u8g.drawFrame(19, 5, 3, 4);
    u8g.drawFrame(2, 2, 18, 10);
    if (vcc > 3600) {
      u8g.drawBox(4, 4, 4, 6);
    }
    if (vcc > 3700) {
      u8g.drawBox(9, 4, 4, 6);
    }
    if (vcc > 3800) {
      u8g.drawBox(14, 4, 4, 6);
    }
  }
}


void setup() {
  Wire.begin();
  pinMode(4, INPUT);
  digitalWrite(4, HIGH);
  sensor_bmp.begin();
  // sensor_bmp.setSampling(Adafruit_BMP280::MODE_NORMAL,     /* Operating Mode. */
  //                 Adafruit_BMP280::SAMPLING_X2,     /* Temp. oversampling */
  //                 Adafruit_BMP280::SAMPLING_X16,    /* Pressure oversampling */
  //                 Adafruit_BMP280::FILTER_X16,      /* Filtering. */
  //                 Adafruit_BMP280::STANDBY_MS_500); /* Standby time. */
  vRef.begin();
  tone_out1.begin(speaker_pin1);  // выход динамика pin8 -
  tone_out2.begin(speaker_pin2);  // выход динамика pin9 +
  play_welcome_beep();
  // delay(500);

  vario_up_arr[0] = 0.35;
  vario_up_arr[1] = 0.5;
  vario_up_arr[2] = 0.8;
  vario_up_arr[3] = 1.0;

  vario_down_arr[0] = -0.7;
  vario_down_arr[1] = -1;
  vario_down_arr[2] = -1.35;
  vario_down_arr[3] = -1.7;
}

void loop(void) {
  //oled display
  time = millis() / 300;
  u8g.firstPage();

  //--------------max vario-----------
  if (vario > Max_Vario_UP) { Max_Vario_UP = vario; }
  if (vario < Max_Vario_DOWN) { Max_Vario_DOWN = vario; }

  if (Altitude > Max_Altitude) {
    Max_Altitude = Altitude;
  }

  // button
  const int SHORT_PRESS_TIME = 500;
  int currentState = (digitalRead(4));

  if (currentState == LOW) {
    if (buttonState <= 2) {
      buttonState++;
    } else {
      buttonState = 0;
    }
    tone_out2.play(800, 100);
    delay(200);
  }

  //show clock and vario
  // if (lastMillis > 0 && (millis() - lastMillis > 3000)) {
  //   relogio = 0;
  //   lastMillis = 0;
  // }

  float tempo = millis();
  float N1 = 0;
  float N2 = 0;
  float N3 = 0;
  float D1 = 0;
  float D2 = 0;

  Altitude = (sensor_bmp.readAltitude(1013));
  Temperature = (sensor_bmp.readTemperature());

  if (alt_0_count <= 10) {
    Altitude_0 = sensor_bmp.readAltitude(1013);
    alt_0[alt_0_count] = sensor_bmp.readAltitude(1013);
    alt_0_count++;
  }

  if (alt_0_count == 10) {
    for (int i = 0; i <= 10; i++) {
      Altitude_0 += alt_0[i];
    }
    Altitude_0 = Altitude_0 / 10;
  }

  for (int cc = 1; cc <= maxsamples; cc++) {  // average
    alt[(cc - 1)] = alt[cc];
    tim[(cc - 1)] = tim[cc];
  };

  alt[maxsamples] = Altitude;
  tim[maxsamples] = tempo;
  float stime = tim[maxsamples - samples];
  for (int cc = (maxsamples - samples); cc < maxsamples; cc++) {
    N1 += (tim[cc] - stime) * alt[cc];
    N2 += (tim[cc] - stime);
    N3 += (alt[cc]);
    D1 += (tim[cc] - stime) * (tim[cc] - stime);
    D2 += (tim[cc] - stime);
  };

  vario = 1000 * ((samples * N1) - N2 * N3) / (samples * D1 - D2 * D2);

  if (isDebug) {
    buttonState = 0;
    vario_down = -0.3;
  }

  if ((tempo - beep) > Beep_period) {
    beep = tempo;
    if (vario > vario_up_arr[buttonState] && vario < 15) {
      Beep_period = 350 - (vario * 5);
      tone_out1.play((1000 + (100 * vario)), 300 - (vario * 5));  // up
      tone_out2.play((1003 + (100 * vario)), 300 - (vario * 5));
    } else if (vario < vario_down) {  // down
      Beep_period = 200;
      tone_out1.play((500 - (vario)), 340);
      tone_out2.play((503 - (vario)), 340);
    }
  }

  //clock
  // if (decolagem == 1) {  //inicia o cronometro quando detectada a decolagem
  //   if (millis() - UtlTime < 0) {
  //     UtlTime = millis();
  //   } else {
  //     segundo = int((millis() - UtlTime) / 1000);
  //   }
  //   if (segundo > 59) {
  //     segundo = 0;
  //     minuto++;
  //     UtlTime = millis();
  //     if (minuto > 59) {
  //       hora++;
  //       minuto = 0;
  //     }
  //   }
  // } else {
  //   segundo = 00;
  //   minuto = 00;
  //   hora = 00;
  // }

  //----------- screen -----------
  do {
    draw2();
  } while (u8g.nextPage());
  //fim oled display
}